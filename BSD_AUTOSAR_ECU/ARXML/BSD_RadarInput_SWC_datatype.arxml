AUTOSAR XML (schema 00047)
standard types defined: uint16, uint8, float32
