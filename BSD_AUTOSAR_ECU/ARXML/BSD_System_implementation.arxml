AUTOSAR XML (schema 00047)
package /Components/SwcImplementations
  swc implementation BSD_System_Impl: programming-language=C, sw-version=1.16.1, used-code-generator=Embedded Coder 24.1 (R2024a) 19-Nov-2023, vendor-id=0, behavior=BSD_System_IB
    code-descriptors:
      code Code
        artifact-descriptors:
          short-label=BSD_System_c, category=SWSRC
          short-label=BSD_System_h, category=SWHDR
          short-label=BSD_System_private_h, category=SWHDR
          short-label=BSD_System_types_h, category=SWHDR
    resource consumption RsrcCons_BSD_System
