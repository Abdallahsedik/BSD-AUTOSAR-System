AUTOSAR XML (schema 00047)
package /Components/SwcImplementations
  swc implementation BSD_RadarInput_SWC_Impl: programming-language=C, sw-version=1.2.1, used-code-generator=Embedded Coder 24.1 (R2024a) 19-Nov-2023, vendor-id=0, behavior=BSD_RadarInput_SWC_IB
    code-descriptors:
      code Code
        artifact-descriptors:
          short-label=BSD_RadarInput_SWC_c, category=SWSRC
          short-label=BSD_RadarInput_SWC_h, category=SWHDR
          short-label=BSD_RadarInput_SWC_private_h, category=SWHDR
          short-label=BSD_RadarInput_SWC_types_h, category=SWHDR
    resource consumption RsrcCons_BSD_RadarInput_SWC
