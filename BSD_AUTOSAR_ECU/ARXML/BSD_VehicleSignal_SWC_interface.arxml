AUTOSAR XML (schema 00051)
package /Interfaces
  sender receiver interface SRI_VehicleRaw
    4 x data, all with category=VALUE, sw-calibration-access=READ-ONLY:
      Raw_Gear_Position: display-format=%1u, type=uint8
      Raw_Vehicle_Speed: display-format=%5u, type=uint16
      Raw_Turn_Signal: display-format=%1u, type=uint8
      Raw_Steering_Angle: display-format=%d, type=sint16
  sender receiver interface SRI_VehicleData
    4 x data, all with category=VALUE, sw-calibration-access=READ-WRITE:
      Gear_Position: display-format=%1u, type=uint8
      Steering_Angle: display-format=%d, type=float32
      Vehicle_Speed: display-format=%5u, type=float32
      Turn_Signal: display-format=%1u, type=uint8
