AUTOSAR XML (schema 00047)
standard types defined: uint8, float32
