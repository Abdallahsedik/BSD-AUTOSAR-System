AUTOSAR XML (schema 00047)
package /Interfaces
  4 x sender receiver interface:
    SRI_Warning
      data Warning_Status: category=VALUE, sw-addr-method=VAR, sw-calibration-access=READ-WRITE, display-format=%d, type=uint8  # Warning Status
      data LED_Output: category=VALUE, sw-addr-method=VAR, sw-calibration-access=READ-WRITE, display-format=%d, type=uint8  # Blind spot warning LED state
    SRI_RadarData
      4 x data, all with category=VALUE, sw-addr-method=VAR, sw-calibration-access=READ-ONLY:
        Distance_Left: display-format=%2.2f, type=float32  # Longl distance to the nearest target detected by the right rear radar
        Distance_Right: display-format=%2.2f, type=float32  # Longl distance to the nearest target detected by the left rear radar
        Status_Left: display-format=%d, type=uint8
        Status_Right: display-format=%d, type=uint8
    SRI_VehicleData
      4 x data, all with category=VALUE, sw-addr-method=VAR, sw-calibration-access=READ-ONLY:
        Vehicle_Speed: display-format=%3.1f, type=float32  # vehicle speed in km/h
        Gear_Position: display-format=%d, type=uint8  # Current transmission gear position (0=Park, 1=Reverse, 2=Neutral, 3=Drive)
        Turn_Signal: display-format=%d, type=uint8  # Status of the vehicle turn indicator stalk (0=Off, 1=Left, 2=Right)
        Steering_Angle: display-format=%4.1f, type=float32  # Current steering wheel angle in degrees
    SRI_FaultStatus
      data Sensor_L_Fault: category=VALUE, sw-addr-method=VAR, sw-calibration-access=READ-WRITE, display-format=%d, type=uint8  # Fault status flag for the left Rear Radar Sensor (0 = Normal, 1 = Fault)
      data Sensor_R_Fault: category=VALUE, sw-addr-method=VAR, sw-calibration-access=READ-WRITE, display-format=%d, type=uint8  # Fault status flag for the Right Rear Radar Sensor (0 = Normal, 1 = Fault)
