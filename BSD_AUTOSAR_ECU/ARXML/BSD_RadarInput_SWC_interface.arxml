AUTOSAR XML (schema 00047)
package /Interfaces
  sender receiver interface SRI_RadarRaw
    data Raw_Distance: category=VALUE, sw-calibration-access=READ-ONLY, display-format=%5u, type=uint16
    data Raw_Status: category=VALUE, sw-calibration-access=READ-ONLY, display-format=%1u, type=uint8
  sender receiver interface SRI_RadarSensor
    data Distance: category=VALUE, sw-calibration-access=READ-ONLY, display-format=%3.2f, type=float32
    data Status: category=VALUE, sw-calibration-access=READ-ONLY, display-format=%1u, type=uint8
