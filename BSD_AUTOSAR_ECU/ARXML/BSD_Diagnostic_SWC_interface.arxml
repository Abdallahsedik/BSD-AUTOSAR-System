AUTOSAR XML (schema 00047)
package /Interfaces
  4 x sender receiver interface:
    SRI_SensorStatus
      data Status_Left: category=VALUE, sw-calibration-access=READ-ONLY, display-format=%d, type=uint8
      data Status_Right: category=VALUE, sw-calibration-access=READ-ONLY, display-format=%d, type=uint8
    SRI_VehicleStatus
      data Vehicle_Speed: category=VALUE, sw-calibration-access=READ-ONLY, type=float32
      data Gear_Position: category=VALUE, sw-calibration-access=READ-ONLY, display-format=%d, type=uint8
    SRI_WarningStatus
      data Warning_Status: category=VALUE, sw-calibration-access=READ-ONLY, display-format=%d, type=uint8
    SRI_DiagStatus
      data DTC_Active_Count: category=VALUE, sw-calibration-access=READ-WRITE, display-format=%d, type=uint8
      data BSD_Available: category=VALUE, sw-calibration-access=READ-WRITE, display-format=%d, type=uint8
      data System_Health: category=VALUE, sw-calibration-access=READ-WRITE, display-format=%d, type=uint8
