AUTOSAR XML (schema 00047)
package /Interfaces
  sender receiver interface SRI_WarningData
    data Warning_Status: category=VALUE, sw-calibration-access=READ-ONLY, type=uint8
  sender receiver interface SRI_LEDControl
    data LED_Left: category=VALUE, sw-calibration-access=READ-WRITE, type=uint8  # mirror warning left light)
    data Buzzer_Active: category=VALUE, sw-calibration-access=READ-WRITE, type=uint8
    data LED_Right: category=VALUE, sw-calibration-access=READ-WRITE, type=uint8  # mirror warning right light
  sender receiver interface SRI_HMI
    data HMI_Display: category=VALUE, sw-calibration-access=READ-WRITE, type=uint8  # instrument cluster icon
