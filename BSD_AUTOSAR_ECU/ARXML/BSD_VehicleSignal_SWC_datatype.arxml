AUTOSAR XML (schema 00051)
standard types defined: uint16, uint8, sint16, float32
