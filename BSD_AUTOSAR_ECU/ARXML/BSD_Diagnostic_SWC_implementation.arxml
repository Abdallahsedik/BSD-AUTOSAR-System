AUTOSAR XML (schema 00047)
package /Components/SwcImplementations
  swc implementation untitled1_Impl: programming-language=C, sw-version=1.3.1, used-code-generator=Embedded Coder 24.1 (R2024a) 19-Nov-2023, vendor-id=0, behavior=untitled1_IB
    code-descriptors:
      code Code
        artifact-descriptors:
          short-label=BSD_Diagnostic_SWC_c, category=SWSRC
          short-label=BSD_Diagnostic_SWC_h, category=SWHDR
          short-label=BSD_Diagnostic_SWC_private_h, category=SWHDR
          short-label=BSD_Diagnostic_SWC_types_h, category=SWHDR
    resource consumption RsrcCons_BSD_Diagnostic_SWC
