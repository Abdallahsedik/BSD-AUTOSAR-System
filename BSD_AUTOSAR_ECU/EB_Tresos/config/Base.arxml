AUTOSAR XML (schema 00052)
package /Base
  module config Base
    PublishedInformation: PbcfgMSupport=0
    BaseDbg
    CustomStdIncludeFiles
    PostBuildSelectable: ProjectType=None, VariantName=(unset)
    CustomOverrides:
      CustomOverride_MemCpy = 0
      CustomOverride_MemSet = 0
      CustomOverride_MemSetS = 0
      CustomOverride_MemCmp = 0
      CustomOverride_MemCmpS = 0
      CustomOverride_MemBZero = 0
      CustomOverride_MemBZeroS = 0
    BaseTypes:
      BaseType_boolean = unsigned char
      BaseType_uint8 = unsigned char
      BaseType_sint8 = signed char
      BaseType_uint16 = unsigned short
      BaseType_sint16 = short
      BaseType_uint32 = unsigned int
      BaseType_sint32 = int
      BaseType_uint8_least = unsigned int
      BaseType_sint8_least = signed int
      BaseType_uint16_least = unsigned int
      BaseType_sint16_least = signed int
      BaseType_uint32_least = unsigned int
      BaseType_sint32_least = signed int
      BaseType_uint64 = unsigned long long
      BaseType_sint64 = signed long long
      BaseType_float32 = float
      BaseType_float64 = double
      DerivedType_TS_MaxAlignedType = double
      BaseType_Size_char = 1
      BaseType_Alignment_char = 1
      BaseType_AtomicAccess_char = 1
      BaseType_Size_short = 2
      BaseType_Alignment_short = 2
      BaseType_AtomicAccess_short = 1
      BaseType_Size_int = 4
      BaseType_Alignment_int = 4
      BaseType_AtomicAccess_int = 1
      BaseType_Size_long = 4
      BaseType_Alignment_long = 4
      BaseType_AtomicAccess_long = 1
      BaseType_Size_longlong = 8
      BaseType_Alignment_longlong = 8
      BaseType_AtomicAccess_longlong = 0
      BaseType_Size_float = 4
      BaseType_Alignment_float = 4
      BaseType_AtomicAccess_float = 1
      BaseType_Size_double = 8
      BaseType_Alignment_double = 8
      BaseType_AtomicAccess_double = 0
      BaseType_Alignment_nearpointer = 4
      BaseType_Size_nearpointer = 4
      BaseType_Size_farpointer = 4
      BaseType_Alignment_farpointer = 4
      ComplexType_Alignment_struct = 1
      ComplexType_Alignment_array = 1
    BaseCpuConfig: BaseCpuConfig_type=32, BaseCpuConfig_byteorder=LE, BaseCpuConfig_bitorder=LE
    GeneralTypes: BaseGenerateMemAccFiles=1, GeneralTypes_Can_ControllerStateType=1
    BaseEcuConfig: BaseEcuConfigAlwaysExport=0, BaseEcuConfigAsrVersion=r4_0_3
    CommonPublishedInformation: ArMajorVersion=4, ArMinorVersion=6, ArPatchVersion=0, SwMajorVersion=5, SwMinorVersion=6, SwPatchVersion=1, ModuleId=0, VendorId=1, Release=
