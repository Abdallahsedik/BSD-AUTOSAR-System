AUTOSAR XML (schema 00052)
package /Mcu
  module config Mcu: implementation-config-variant=VARIANT-POST-BUILD
    McuGeneralConfiguration: McuDevErrorDetect=0, McuGetRamStateApi=0, McuInitClock=1, McuNoPll=1, McuPerformResetApi=1, McuVersionInfoApi=0
    McuModuleConfiguration: McuClockSrcFailureNotification=DISABLED, McuNumberOfMcuModes=1, McuRamSectors=0
      McuClockSettingConfig_0 (McuClockSettingConfig): McuClockSettingId=0
        McuClockReferencePoint_0 (McuClockReferencePoint): McuClockReferencePointFrequency=1000.0
      McuModeSettingConf_0 (McuModeSettingConf): McuMode=0
    McuPublishedInformation
      4 x McuResetReasonConf, all with McuResetReason=0:
        MCU_POWER_ON_RESET
        MCU_WATCHDOG_RESET
        MCU_SW_RESET
        MCU_RESET_UNDEFINED
