AUTOSAR XML (schema 00052)
package /CanIf
  module config CanIf: implementation-config-variant=VARIANT-POST-BUILD
    PublishedInformation: PbcfgMSupport=1
    BSD_CanIfCtrlDrv (CanIfCtrlDrvCfg): CanIfCtrlDrvInitHohConfigRef=CanIfInitHohCfg
      CanIfCtrlCfg_0 (CanIfCtrlCfg): CanIfCtrlId=0, CanIfCtrlWakeupSupport=0, CanIfCtrlCanCtrlRef=CanController_0
    CanIfDispatchCfg:
      CanIfDispatchUserCtrlBusOffUL = CAN_SM
      CanIfDispatchUserCtrlModeIndicationUL = CAN_SM
      CanIfDispatchUserConfirmPnAvailabilityName = (unset)
      CanIfDispatchUserConfirmPnAvailabilityUL = CAN_SM
    CanIfInit_Cfg (CanIfInitCfg): CanIfInitCfgSet=
      HTH_Warning_Buffer (CanIfBufferCfg): CanIfBufferSize=0, CanIfBufferHthRef=HTH_Warning
      HTH_LED_Buffer (CanIfBufferCfg): CanIfBufferSize=0, CanIfBufferHthRef=HTH_LED
      CanIfInitHohCfg
        6 x CanIfHrhCfg, all with CanIfHrhSoftwareFilter=1, CanIfHrhCanCtrlIdRef=CanIfCtrlCfg_0:
          HRH_Radar_Left: CanIfHrhIdSymRef=HwObject_0
          HRH_Radar_Right: CanIfHrhIdSymRef=HwObject_1
          HRH_Speed: CanIfHrhIdSymRef=HwObject_2
          HRH_TurnSignal: CanIfHrhIdSymRef=HwObject_3
          HRH_Steering: CanIfHrhIdSymRef=HwObject_4
          HRH_Gear: CanIfHrhIdSymRef=HwObject_5
        HTH_Warning (CanIfHthCfg): CanIfHthCanCtrlIdRef=CanIfCtrlCfg_0, CanIfHthIdSymRef=HwObject_7
        HTH_LED (CanIfHthCfg): CanIfHthCanCtrlIdRef=CanIfCtrlCfg_0, CanIfHthIdSymRef=HwObject_8
      6 x CanIfRxPduCfg, all with CanIfRxPduCanIdType=STANDARD_CAN, CanIfRxPduDataLengthCheck=1, CanIfRxPduReadData=0, CanIfRxPduReadNotifyStatus=0, CanIfRxPduUserRxIndicationUL=PDUR:
        BSD_Radar_Left_PDU: CanIfRxPduCanId=512, CanIfRxPduDataLength=8, CanIfRxPduId=0, CanIfRxPduHrhIdRef=HRH_Radar_Left, CanIfRxPduRef=Pdu_Radar_Left
        BSD_Radar_Right_PDU: CanIfRxPduCanId=513, CanIfRxPduDataLength=8, CanIfRxPduId=1, CanIfRxPduHrhIdRef=HRH_Radar_Right, CanIfRxPduRef=Pdu_Radar_Right
        BSD_Speed_PDU: CanIfRxPduCanId=256, CanIfRxPduDataLength=2, CanIfRxPduId=2, CanIfRxPduHrhIdRef=HRH_Speed, CanIfRxPduRef=Pdu_Speed
        BSD_TurnSignal_PDU: CanIfRxPduCanId=928, CanIfRxPduDataLength=1, CanIfRxPduId=3, CanIfRxPduHrhIdRef=HRH_TurnSignal, CanIfRxPduRef=Pdu_TurnSignal
        BSD_Steering_PDU: CanIfRxPduCanId=736, CanIfRxPduDataLength=2, CanIfRxPduId=4, CanIfRxPduHrhIdRef=HRH_Steering, CanIfRxPduRef=Pdu_Steering
        BSD_Gear_PDU: CanIfRxPduCanId=416, CanIfRxPduDataLength=1, CanIfRxPduId=5, CanIfRxPduHrhIdRef=HRH_Gear, CanIfRxPduRef=Pdu_Gear
      BSD_Warning_TxPDU (CanIfTxPduCfg):
        CanIfTxPduCanId = 768
        CanIfTxPduId = 0
        CanIfTxPduReadNotifyStatus = 0
        CanIfTxPduTruncation = 0
        CanIfTxPduType = STATIC
        CanIfTxPduUserTxConfirmationUL = PDUR
        CanIfTxPduCanIdType = STANDARD_CAN
        CanIfTxPduBufferRef = HTH_Warning_Buffer
        CanIfTxPduRef = Pdu_Warning_Tx
      BSD_LED_TxPDU (CanIfTxPduCfg):
        CanIfTxPduCanId = 769
        CanIfTxPduId = 1
        CanIfTxPduReadNotifyStatus = 0
        CanIfTxPduTruncation = 0
        CanIfTxPduType = STATIC
        CanIfTxPduUserTxConfirmationUL = PDUR
        CanIfTxPduCanIdType = STANDARD_CAN
        CanIfTxPduBufferRef = HTH_LED_Buffer
        CanIfTxPduRef = Pdu_LED_Tx
    CanIfPrivateCfg: CanIfFixedBuffer=0, CanIfPrivateDataLengthCheck=1, CanIfPrivateSoftwareFilterType=BINARY, CanIfSupportTTCAN=0
    CanIfPublicCfg:
      CanIfPublicCancelTransmitSupport = 0
      CanIfDevErrorDetect = 0
      CanIfPublicHandleTypeEnum = UINT16
      CanIfPublicMultipleDrvSupport = 0
      CanIfPublicPnSupport = 0
      CanIfPublicReadRxPduDataApi = 0
      CanIfPublicReadRxPduNotifyStatusApi = 0
      CanIfPublicReadTxPduNotifyStatusApi = 0
      CanIfPublicSetDynamicTxIdApi = 0
      CanIfPublicTxBuffering = 0
      CanIfPublicTxConfirmPollingSupport = 0
      CanIfVersionInfoApi = 0
      CanIfPublicWakeupCheckValidSupport = 0
      CanIfTriggerTransmitSupport = 0
      CanIfTxOfflineActiveSupport = 0
      CanIfPublicWakeupCheckValidByNM = 0
      CanIfEnableSecurityEventReporting = 0
      CanIfDetReportRuntimeError = 1
      CanIfDecoupledProcessingSupport = 0
      CanIfMultiCoreSupport = 0
      CanIfRelocatablePbcfgEnable = 1
      CanIfSoftwareFilteringSupport = 1
      CanIfCanDriverCompatibility = ASR440
      CanIfPublicCanIdTypeEnum = UINT32
      CanIfPublicSingleCtrlOpt = 0
      CanIfPublicHohTranslationOpt = 0
      CanIfPublicCtrlWakeupSupport = 0
      CanIfPublicRangeReceptionSupport = 1
      CanIfPublicTrcvSupport = 0
      CanIfPublicMaxCtrl = 1
      CanIfPublicMaxTxPdus = 3
      CanIfSingleCanTrcvAPIInfixEnable = 1
      CanIfHookOnReceptionSupport = 0
      CanIfSetBaudrateApi = 0
      CanIfBusMirroringSupport = 0
      CanIfMetaDataSupport = 0
    CanIfDefensiveProgramming:
      CanIfDefProgEnabled = 0
      CanIfPrecondAssertEnabled = 0
      CanIfPostcondAssertEnabled = 0
      CanIfStaticAssertEnabled = 0
      CanIfUnreachAssertEnabled = 0
      CanIfInvariantAssertEnabled = 0
    CanIfDecoupledMeasurementSupport
    7 x CanIfUpperLayerConfig, all with CanIfUpperLayerUseCanId=0:
      CAN_NM: CanIfPublicTxConfResultSupport=1, CanIfTxPduUserTxConfirmationName=CanNm_TxConfirmation, CanIfRxPduUserRxIndicationName=CanNm_RxIndication
      CAN_TP: CanIfPublicTxConfResultSupport=0, CanIfTxPduUserTxConfirmationName=CanTp_TxConfirmation, CanIfRxPduUserRxIndicationName=CanTp_RxIndication
      CAN_TSYN: CanIfPublicTxConfResultSupport=1, CanIfTxPduUserTxConfirmationName=CanTSyn_TxConfirmation, CanIfRxPduUserRxIndicationName=CanTSyn_RxIndication
      PDUR: CanIfPublicTxConfResultSupport=1, CanIfTxPduUserTxConfirmationName=PduR_CanIfTxConfirmation, CanIfRxPduUserRxIndicationName=PduR_CanIfRxIndication
      J1939NM: CanIfPublicTxConfResultSupport=1, CanIfTxPduUserTxConfirmationName=J1939Nm_TxConfirmation, CanIfRxPduUserRxIndicationName=J1939Nm_RxIndication
      J1939TP: CanIfPublicTxConfResultSupport=1, CanIfTxPduUserTxConfirmationName=J1939Tp_TxConfirmation, CanIfRxPduUserRxIndicationName=J1939Tp_RxIndication
      XCP: CanIfPublicTxConfResultSupport=1, CanIfTxPduUserTxConfirmationName=Xcp_CanIfTxConfirmation, CanIfRxPduUserRxIndicationName=Xcp_CanIfRxIndication
    CanIfMirroringSupport
    CanIfHookOnRxSupport
    CommonPublishedInformation: ArMajorVersion=4, ArMinorVersion=6, ArPatchVersion=0, SwMajorVersion=7, SwMinorVersion=0, SwPatchVersion=11, ModuleId=60, VendorId=1, Release=
