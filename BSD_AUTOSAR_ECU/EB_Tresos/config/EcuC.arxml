AUTOSAR XML (schema 00052)
package /EcuC
  module config EcuC: implementation-config-variant=VARIANT-POST-BUILD
    PublishedInformation: PbcfgMSupport=0
    CommonPublishedInformation: ArMajorVersion=4, ArMinorVersion=8, ArPatchVersion=0, SwMajorVersion=6, SwMinorVersion=1, SwPatchVersion=0, ModuleId=32786, VendorId=1, Release=
    EcucConfigSet
      EcucPduCollection: PduIdTypeEnum=UINT16, PduLengthTypeEnum=UINT16
        8 x Pdu:
          Pdu_Radar_Left: PduLength=8
          Pdu_Radar_Right: PduLength=8
          Pdu_Speed: PduLength=2
          Pdu_TurnSignal: PduLength=1
          Pdu_Steering: PduLength=2
          Pdu_Gear: PduLength=1
          Pdu_LED_Tx: PduLength=2
          Pdu_Warning_Tx: PduLength=2
    EcucGeneral: EcucDevErrorDetect=1, EcucMetaDataHandlingEnabled=1
