AUTOSAR XML (schema 00051)
package /Components/SwcImplementations
  swc implementation VehicleSignals_Impl: programming-language=C, sw-version=1.56.1, used-code-generator=Embedded Coder 24.1 (R2024a) 19-Nov-2023, vendor-id=0, behavior=VehicleSignals_IB
    code-descriptors:
      code Code
        artifact-descriptors:
          short-label=VehicleSignals_c, category=SWSRC
          short-label=VehicleSignals_h, category=SWHDR
          short-label=VehicleSignals_private_h, category=SWHDR
          short-label=VehicleSignals_types_h, category=SWHDR
    resource consumption RsrcCons_VehicleSignals
