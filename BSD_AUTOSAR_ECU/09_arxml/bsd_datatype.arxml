AUTOSAR XML (schema 00051)
standard types defined: float32, uint16, uint8, sint16, sint32
package /DataTypes
  7 x impl type, all with category=VALUE, base-type=sint32:
    SignalStatus_T: compu {0=SIGNAL_OK, 1=SIGNAL_FAIL}
    Gear_T: compu {0=GEAR_PARK, 1=GEAR_REVERSE, 2=GEAR_NEUTRAL, 3=GEAR_DRIVE}
    TurnSignal_T: compu {0=TURN_OFF, 1=TURN_LEFT, 2=TURN_RIGHT}
    RadarStatus_T: compu {0=RADAR_OK, 1=RADAR_FAIL}
    BSDState_T: compu {0=BSD_CLEAR, 1=BSD_WARNING, 1=BSD_ALERT}
    DiagEventStatus_T: compu {0=DIAG_EVT_PASSED, 1=DIAG_EVT_FAILED}
    LedState_T: compu {0=LED_OFF, 1=LED_ON}
package /DataTypes/Units
  unit NoUnit: factor-si-to-unit=1, offset-si-to-unit=0
package /DataTypes/ApplDataTypes
  9 x app type, all with category=VALUE, sw-calibration-access=READ-WRITE, compu {identical}:
    Steering_Angle: range phys -INF..INF
    Vehicle_Speed: range phys -INF..INF
    Distance: range phys -INF..INF
    Distance_Raw: range phys 0..65535
    Status_Raw: range phys 0..255
    Vehicle_Speed_Raw: range phys 0..65535
    Raw_turn_sig: range phys 0..255
    Raw_steering: range phys -32768..32767
    Gear_Raw: range phys 0..255
package /DataTypes/DataTypeMappings
  data type mapping set bsdDataTypeMappingsSet
    data-type-maps:
      application-data-type=Steering_Angle, implementation-data-type=float32
      application-data-type=Vehicle_Speed, implementation-data-type=float32
      application-data-type=Distance, implementation-data-type=float32
      application-data-type=Distance_Raw, implementation-data-type=uint16
      application-data-type=Status_Raw, implementation-data-type=uint8
      application-data-type=Vehicle_Speed_Raw, implementation-data-type=uint16
      application-data-type=Raw_turn_sig, implementation-data-type=uint8
      application-data-type=Raw_steering, implementation-data-type=sint16
      application-data-type=Gear_Raw, implementation-data-type=uint8
