AUTOSAR XML (schema 00051)
package /Components/SwcImplementations
  swc implementation Algorithm_Impl: programming-language=C, sw-version=1.21.1, used-code-generator=Embedded Coder 24.1 (R2024a) 19-Nov-2023, vendor-id=0, behavior=Algorithm_IB
    code-descriptors:
      code Code
        artifact-descriptors:
          short-label=Algorithm_c, category=SWSRC
          short-label=Algorithm_h, category=SWHDR
          short-label=Algorithm_private_h, category=SWHDR
          short-label=Algorithm_types_h, category=SWHDR
    resource consumption RsrcCons_Algorithm
