AUTOSAR XML (schema 00051)
package /Components/SwcImplementations
  swc implementation Warning_Impl: programming-language=C, sw-version=1.11.1, used-code-generator=Embedded Coder 24.1 (R2024a) 19-Nov-2023, vendor-id=0, behavior=Warning_IB
    code-descriptors:
      code Code
        artifact-descriptors:
          short-label=Warning_c, category=SWSRC
          short-label=Warning_h, category=SWHDR
          short-label=Warning_private_h, category=SWHDR
          short-label=Warning_types_h, category=SWHDR
    resource consumption RsrcCons_Warning
