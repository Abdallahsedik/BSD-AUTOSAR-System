AUTOSAR XML (schema 00051)
package /Components/SwcImplementations
  swc implementation Diagnostic_Impl: programming-language=C, sw-version=1.18.1, used-code-generator=Embedded Coder 24.1 (R2024a) 19-Nov-2023, vendor-id=0, behavior=Diagnostic_IB
    code-descriptors:
      code Code
        artifact-descriptors:
          short-label=Diagnostic_c, category=SWSRC
          short-label=Diagnostic_h, category=SWHDR
          short-label=Diagnostic_private_h, category=SWHDR
          short-label=Diagnostic_types_h, category=SWHDR
    resource consumption RsrcCons_Diagnostic
