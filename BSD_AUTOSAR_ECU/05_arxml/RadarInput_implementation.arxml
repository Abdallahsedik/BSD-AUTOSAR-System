AUTOSAR XML (schema 00051)
package /Components/SwcImplementations
  swc implementation RadarInput_Impl: programming-language=C, sw-version=1.79.1, used-code-generator=Embedded Coder 24.1 (R2024a) 19-Nov-2023, vendor-id=0, behavior=RadarInput_IB
    code-descriptors:
      code Code
        artifact-descriptors:
          short-label=RadarInput_c, category=SWSRC
          short-label=RadarInput_h, category=SWHDR
          short-label=RadarInput_private_h, category=SWHDR
          short-label=RadarInput_types_h, category=SWHDR
    resource consumption RsrcCons_RadarInput
