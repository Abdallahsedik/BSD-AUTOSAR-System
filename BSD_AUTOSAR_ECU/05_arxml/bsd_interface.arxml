AUTOSAR XML (schema 00051)
package /Interfaces
  10 x sender receiver interface:
    SRI_RadarRaw
      data Distance_Raw: category=VALUE, sw-calibration-access=READ-ONLY, type=Distance_Raw
      data Status_Raw: category=VALUE, sw-calibration-access=READ-ONLY, type=Status_Raw
    SRI_SpeedRaw
      data Vehicle_Speed_Raw: category=VALUE, sw-calibration-access=READ-ONLY, type=Vehicle_Speed_Raw
    SRI_TurnSignalRaw
      data Raw_turn_sig: category=VALUE, sw-calibration-access=READ-ONLY, type=Raw_turn_sig
    SRI_GearRaw
      data Gear_Raw: category=VALUE, sw-calibration-access=READ-ONLY, type=Gear_Raw
    SRI_SteeringRaw
      data Raw_steering: category=VALUE, sw-calibration-access=READ-ONLY, type=Raw_steering
    SRI_RadarData
      data Status: category=VALUE, sw-calibration-access=READ-ONLY, type=RadarStatus_T
      data Distance: category=VALUE, sw-calibration-access=READ-ONLY, type=Distance
    SRI_VehicleData
      8 x data, all with category=VALUE, sw-calibration-access=READ-ONLY:
        Steering_Status: type=SignalStatus_T
        Steering_Angle: type=Steering_Angle
        Gear_Status: type=SignalStatus_T
        Gear: type=Gear_T
        TurnSignal_Status: type=SignalStatus_T
        TurnSignal: type=TurnSignal_T
        Vehicle_Speed: type=Vehicle_Speed
        Speed_Status: type=SignalStatus_T
    SRI_AlgorithmState
      data BSD_State_Right: category=VALUE, sw-calibration-access=READ-ONLY, type=BSDState_T
      data BSD_State_Left: category=VALUE, sw-calibration-access=READ-ONLY, type=BSDState_T
    SRI_WarningOutput
      4 x data, all with category=VALUE, sw-calibration-access=READ-ONLY:
        LED_Right: type=LedState_T
        LED_Left: type=LedState_T
        Warning_State_Left: type=BSDState_T
        Warning_State_Right: type=BSDState_T
    SRI_DiagStatus
      6 x data, all with category=VALUE, sw-calibration-access=READ-ONLY, type=DiagEventStatus_T:
        Steering_Event
        Radar_Left_Event
        Radar_Right_Event
        Speed_Event
        TurnSignal_Event
        Gear_Event
