AUTOSAR XML (schema 00051)
package /Interfaces
  sender receiver interface WarningOutput_If
    data WarningStatus: category=VALUE, display-format=%1.0f, type=uint8  # Warning Status
    data LED_Output: category=VALUE, type=uint8  # Blind spot warning LED state
  sender receiver interface VehicleSignal_If
    data TurnSignal__: category=VALUE, type=uint8  # Driver turn signal indicator
    data VehicleSpeed: category=VALUE, display-format=%3.0f, type=float32  # Vehicle Speed
  sender receiver interface RadarSensor_If
    data Distance: category=VALUE, display-format=%4.2f, type=float32  # Radar measured distance in meters
