AUTOSAR XML (schema 00052)
package /Can
  module config Can: implementation-config-variant=VARIANT-POST-BUILD
    CanConfigSet
      CanController_0 (CanController):
        CanBusoffProcessing = INTERRUPT
        CanControllerActivation = 1
        CanControllerBaseAddress = 0
        CanControllerId = 0
        CanRxProcessing = INTERRUPT
        CanTxProcessing = INTERRUPT
        CanWakeupFunctionalityAPI = 0
        CanWakeupProcessing = INTERRUPT
        CanWakeupSupport = 0
        CanControllerDefaultBaudrate = CanControllerBaudrateConfig_0
        CanCpuClockRef = McuClockReferencePoint_0
        CanControllerBaudrateConfig_0 (CanControllerBaudrateConfig):
          CanControllerBaudRate = 500
          CanControllerBaudRateConfigID = 0
          CanControllerPropSeg = 6
          CanControllerSeg1 = 7
          CanControllerSeg2 = 2
          CanControllerSyncJumpWidth = 1
      10 x CanHardwareObject, all with CanHwObjectCount=1, CanIdType=STANDARD, CanControllerRef=CanController_0:
        HwObject_0: CanHandleType=BASIC, CanObjectId=0, CanObjectType=RECEIVE
          CanHwFilter_0 (CanHwFilter): CanHwFilterCode=512, CanHwFilterMask=2046
        HwObject_1: CanHandleType=BASIC, CanObjectId=1, CanObjectType=RECEIVE
          CanHwFilter: CanHwFilterCode=513, CanHwFilterMask=2046
        HwObject_2: CanHandleType=FULL, CanObjectId=2, CanObjectType=RECEIVE
          CanHwFilter: CanHwFilterCode=256, CanHwFilterMask=2047
        HwObject_3: CanHandleType=FULL, CanObjectId=3, CanObjectType=RECEIVE
          CanHwFilter: CanHwFilterCode=928, CanHwFilterMask=2047
        HwObject_4: CanHandleType=FULL, CanObjectId=4, CanObjectType=RECEIVE
          CanHwFilter: CanHwFilterCode=736, CanHwFilterMask=2047
        HwObject_5: CanHandleType=FULL, CanObjectId=5, CanObjectType=RECEIVE
          CanHwFilter: CanHwFilterCode=416, CanHwFilterMask=2047
        HwObject_6: CanHandleType=FULL, CanObjectId=6, CanObjectType=RECEIVE
          CanHwFilter: CanHwFilterCode=2015, CanHwFilterMask=2047
        HwObject_{7..9}: CanHandleType=FULL, CanObjectId={7..9}, CanObjectType=TRANSMIT
    CanGeneral:
      CanDevErrorDetect = 1
      CanIfARVersion = AR4_0_1
      CanIndex = 0
      CanMainFunctionModePeriod = 0.01
      CanMultiplexedTransmission = 0
      CanPublicIcomSupport = 0
      CanSynchronousModeIndication = 0
      CanTimeoutDuration = 0.001
      CanVersionInfoApi = 0
      CanSupportTTCANRef = CanIfPrivateCfg
